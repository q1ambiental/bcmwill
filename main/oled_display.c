#include "oled_display.h"
#include "bcm_config.h"
#include "driver/i2c_master.h"
#include "esp_log.h"
#include <string.h>

static const char *TAG = "OLED";
static i2c_master_bus_handle_t s_bus;
static i2c_master_dev_handle_t s_dev;
static uint8_t s_fb[OLED_WIDTH * OLED_HEIGHT / 8];

/* Fonte 5x7 (ASCII 0x20..0x7F) — 5 colunas por caractere */
static const uint8_t FONT5x7[][5] = {
 {0x00,0x00,0x00,0x00,0x00},{0x00,0x00,0x5F,0x00,0x00},{0x00,0x07,0x00,0x07,0x00},
 {0x14,0x7F,0x14,0x7F,0x14},{0x24,0x2A,0x7F,0x2A,0x12},{0x23,0x13,0x08,0x64,0x62},
 {0x36,0x49,0x55,0x22,0x50},{0x00,0x05,0x03,0x00,0x00},{0x00,0x1C,0x22,0x41,0x00},
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 {0x00,0x41,0x36,0x08,0x00},{0x08,0x04,0x08,0x10,0x08},
};

static esp_err_t send_cmd(uint8_t c)
{
    uint8_t buf[2] = { 0x00, c };
    return i2c_master_transmit(s_dev, buf, 2, 50);
}
static esp_err_t send_data(const uint8_t *d, size_t n)
{
    uint8_t buf[OLED_WIDTH + 1];
    buf[0] = 0x40;
    memcpy(&buf[1], d, n);
    return i2c_master_transmit(s_dev, buf, n + 1, 100);
}

esp_err_t oled_init(void)
{
    i2c_master_bus_config_t bus_cfg = {
        .i2c_port = BCM_I2C_PORT,
        .sda_io_num = BCM_I2C_SDA_GPIO,
        .scl_io_num = BCM_I2C_SCL_GPIO,
        .clk_source = I2C_CLK_SRC_DEFAULT,
        .glitch_ignore_cnt = 7,
        .flags.enable_internal_pullup = true,
    };
    ESP_ERROR_CHECK(i2c_new_master_bus(&bus_cfg, &s_bus));

    i2c_device_config_t dev_cfg = {
        .dev_addr_length = I2C_ADDR_BIT_LEN_7,
        .device_address  = OLED_I2C_ADDR,
        .scl_speed_hz    = BCM_I2C_FREQ_HZ,
    };
    ESP_ERROR_CHECK(i2c_master_bus_add_device(s_bus, &dev_cfg, &s_dev));

    static const uint8_t init_cmds[] = {
        0xAE,0x20,0x00,0xB0,0xC8,0x00,0x10,0x40,0x81,0x7F,0xA1,0xA6,0xA8,0x3F,
        0xA4,0xD3,0x00,0xD5,0x80,0xD9,0xF1,0xDA,0x12,0xDB,0x40,0x8D,0x14,0xAF
    };
    for (size_t i = 0; i < sizeof(init_cmds); i++) send_cmd(init_cmds[i]);

    oled_clear(); oled_update();
    ESP_LOGI(TAG, "SSD1306 128x64 pronto em 0x%02X", OLED_I2C_ADDR);
    return ESP_OK;
}

void oled_clear(void) { memset(s_fb, 0, sizeof(s_fb)); }

void oled_update(void)
{
    for (int page = 0; page < 8; page++) {
        send_cmd(0xB0 + page);
        send_cmd(0x00);
        send_cmd(0x10);
        send_data(&s_fb[page * OLED_WIDTH], OLED_WIDTH);
    }
}

void oled_draw_pixel(int x, int y, int color)
{
    if (x < 0 || x >= OLED_WIDTH || y < 0 || y >= OLED_HEIGHT) return;
    int idx = x + (y / 8) * OLED_WIDTH;
    if (color) s_fb[idx] |=  (1 << (y & 7));
    else       s_fb[idx] &= ~(1 << (y & 7));
}

void oled_draw_text(int x, int y, const char *str, int color)
{
    while (*str) {
        if (*str < 0x20 || *str > 0x7F) { str++; continue; }
        const uint8_t *glyph = FONT5x7[(int)(*str - 0x20)];
        for (int c = 0; c < 5; c++) {
            uint8_t col = glyph[c];
            for (int r = 0; r < 7; r++) {
                if (col & (1 << r))
                    oled_draw_pixel(x + c, y + r, color);
            }
        }
        x += 6;
        str++;
        if (x > OLED_WIDTH - 6) break;
    }
}

void oled_draw_hline(int x, int y, int w, int color)
{ for (int i = 0; i < w; i++) oled_draw_pixel(x + i, y, color); }

void oled_draw_vline(int x, int y, int h, int color)
{ for (int i = 0; i < h; i++) oled_draw_pixel(x, y + i, color); }

void oled_draw_rect(int x, int y, int w, int h, int color)
{
    oled_draw_hline(x, y, w, color);
    oled_draw_hline(x, y + h - 1, w, color);
    oled_draw_vline(x, y, h, color);
    oled_draw_vline(x + w - 1, y, h, color);
}

void oled_draw_fill_rect(int x, int y, int w, int h, int color)
{
    for (int j = 0; j < h; j++)
        for (int i = 0; i < w; i++)
            oled_draw_pixel(x + i, y + j, color);
}